## config/boards/shields/raven/Kconfig.defconfig
```kconfig
# Copyright (c) 2020 The ZMK Contributors
# SPDX-License-Identifier: MIT

if SHIELD_RAVEN_LEFT

config ZMK_KEYBOARD_NAME
	default "Flying Raven"

config ZMK_SPLIT_ROLE_CENTRAL
	default y

endif

if SHIELD_RAVEN_LEFT || SHIELD_RAVEN_RIGHT

config ZMK_SPLIT
	default y

endif
```

## config/west.yml
```yaml
manifest:
  remotes:
    - name: zmkfirmware
      url-base: https://github.com/zmkfirmware
    - name: EmileVezinaCoulombe
      url-base: https://github.com/EmileVezinaCoulombe
  projects: 
    - name: zmk
      remote: EmileVezinaCoulombe
      revision: master
      import: app/west.yml
  self:
    path: config
```
